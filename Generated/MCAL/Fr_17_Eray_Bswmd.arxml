AUTOSAR XML (schema 4-2-2)
# Copyright (C) Infineon Technologies (2020)
# All rights reserved.
package /AUTOSAR_Fr_17_Eray/BswModuleDescriptions
  bsw module description Fr: category=BSW_MODULE, module-id=81  # FR Driver
    provided-entrys:
      Fr_Init
      Fr_ControllerInit
      Fr_AllSlots
      Fr_AllowColdstart
      Fr_StartCommunication
      Fr_GetPOCStatus
      Fr_GetGlobalTime
      Fr_PrepareLPdu
      Fr_TransmitTxLPdu
      Fr_CheckTxLPduStatus
      Fr_ReceiveRxLPdu
      Fr_GetNmVector
      Fr_CancelTxLPdu
      Fr_DisableLPdu
      Fr_SetWakeupChannel
      Fr_SendWUP
      Fr_SetAbsoluteTimer
      Fr_EnableAbsoluteTimerIRQ
      Fr_GetAbsoluteTimerIRQStatus
      Fr_AckAbsoluteTimerIRQ
      Fr_DisableAbsoluteTimerIRQ
      Fr_CancelAbsoluteTimer
      Fr_GetChannelStatus
      Fr_GetNumOfStartupFrames
      Fr_GetClockCorrection
      Fr_GetSyncFrameList
      Fr_GetWakeupRxStatus
      Fr_ReadCCConfig
      Fr_AbortCommunication
      Fr_HaltCommunication
      Fr_ReconfigLPdu
      Fr_GetVersionInfo
    bsw module dependency DetDependency: target-module-id=15, required-entrys=Det_ReportError
    bsw module dependency DemDependency: target-module-id=54, required-entrys=Dem_ReportErrorStatus
    bsw module dependency McalLibDependency: target-module-id=255, required-entrys=[Mcal_DelayTickResolution, Mcal_DelayGetTick, Mcal_WritePeripEndInitProtReg]
    bsw internal behavior FrBehavior
      exclusive area ConfigLockKey
      32 x bsw called entity:
        Fr_Init: reentrancy-level=NON-REENTRANT, implemented-entry=Fr_Init
        Fr_ControllerInit: can-enter-exclusive-area=ConfigLockKey, reentrancy-level=SINGLE-CORE-REENTRANT, implemented-entry=Fr_ControllerInit
        Fr_AllSlots: reentrancy-level=SINGLE-CORE-REENTRANT, implemented-entry=Fr_AllSlots
        Fr_AllowColdstart: reentrancy-level=SINGLE-CORE-REENTRANT, implemented-entry=Fr_AllowColdstart
        Fr_StartCommunication: reentrancy-level=SINGLE-CORE-REENTRANT, implemented-entry=Fr_StartCommunication
        Fr_GetPOCStatus: reentrancy-level=SINGLE-CORE-REENTRANT, implemented-entry=Fr_GetPOCStatus
        Fr_GetGlobalTime: reentrancy-level=SINGLE-CORE-REENTRANT, implemented-entry=Fr_GetGlobalTime
        Fr_PrepareLPdu: reentrancy-level=SINGLE-CORE-REENTRANT, implemented-entry=Fr_PrepareLPdu
        Fr_TransmitTxLPdu: reentrancy-level=SINGLE-CORE-REENTRANT, implemented-entry=Fr_TransmitTxLPdu
        Fr_CheckTxLPduStatus: reentrancy-level=SINGLE-CORE-REENTRANT, implemented-entry=Fr_CheckTxLPduStatus
        Fr_ReceiveRxLPdu: reentrancy-level=SINGLE-CORE-REENTRANT, implemented-entry=Fr_ReceiveRxLPdu
        Fr_GetNmVector: reentrancy-level=SINGLE-CORE-REENTRANT, implemented-entry=Fr_GetNmVector
        Fr_CancelTxLPdu: reentrancy-level=SINGLE-CORE-REENTRANT, implemented-entry=Fr_CancelTxLPdu
        Fr_DisableLPdu: reentrancy-level=SINGLE-CORE-REENTRANT, implemented-entry=Fr_DisableLPdu
        Fr_SetWakeupChannel: can-enter-exclusive-area=ConfigLockKey, reentrancy-level=SINGLE-CORE-REENTRANT, implemented-entry=Fr_SetWakeupChannel
        Fr_SendWUP: reentrancy-level=SINGLE-CORE-REENTRANT, implemented-entry=Fr_SendWUP
        Fr_SetAbsoluteTimer: reentrancy-level=SINGLE-CORE-REENTRANT, implemented-entry=Fr_SetAbsoluteTimer
        Fr_EnableAbsoluteTimerIRQ: reentrancy-level=SINGLE-CORE-REENTRANT, implemented-entry=Fr_EnableAbsoluteTimerIRQ
        Fr_GetAbsoluteTimerIRQStatus: reentrancy-level=SINGLE-CORE-REENTRANT, implemented-entry=Fr_GetAbsoluteTimerIRQStatus
        Fr_AckAbsoluteTimerIRQ: reentrancy-level=SINGLE-CORE-REENTRANT, implemented-entry=Fr_AckAbsoluteTimerIRQ
        Fr_DisableAbsoluteTimerIRQ: reentrancy-level=SINGLE-CORE-REENTRANT, implemented-entry=Fr_DisableAbsoluteTimerIRQ
        Fr_CancelAbsoluteTimer: reentrancy-level=SINGLE-CORE-REENTRANT, implemented-entry=Fr_CancelAbsoluteTimer
        Fr_GetChannelStatus: reentrancy-level=SINGLE-CORE-REENTRANT, implemented-entry=Fr_GetChannelStatus
        Fr_GetNumOfStartupFrames: reentrancy-level=SINGLE-CORE-REENTRANT, implemented-entry=Fr_GetNumOfStartupFrames
        Fr_GetClockCorrection: reentrancy-level=SINGLE-CORE-REENTRANT, implemented-entry=Fr_GetClockCorrection
        Fr_GetSyncFrameList: reentrancy-level=SINGLE-CORE-REENTRANT, implemented-entry=Fr_GetSyncFrameList
        Fr_GetWakeupRxStatus: reentrancy-level=SINGLE-CORE-REENTRANT, implemented-entry=Fr_GetWakeupRxStatus
        Fr_ReadCCConfig: reentrancy-level=SINGLE-CORE-REENTRANT, implemented-entry=Fr_ReadCCConfig
        Fr_AbortCommunication: reentrancy-level=SINGLE-CORE-REENTRANT, implemented-entry=Fr_AbortCommunication
        Fr_HaltCommunication: reentrancy-level=SINGLE-CORE-REENTRANT, implemented-entry=Fr_HaltCommunication
        Fr_ReconfigLPdu: reentrancy-level=SINGLE-CORE-REENTRANT, implemented-entry=Fr_ReconfigLPdu
        Fr_GetVersionInfo: reentrancy-level=SINGLE-CORE-REENTRANT, implemented-entry=Fr_GetVersionInfo
      service-needs:
        diagnostic event needs FR_E_CTRL_TESTRESULT
      service-needs:
        diagnostic event needs FRIF_E_LPDU_SLOTSTATUS
package /AUTOSAR_Fr_17_Eray/BswModuleEntrys
  32 x bsw module entry, all with call-type=REGULAR, execution-context=TASK, sw-service-impl-policy=STANDARD:
    Fr_Init: service-id=28, is-reentrant=false, is-synchronous=true
      sw service arg Fr_ConfigPtr: category=DATA_REFERENCE, sw-pointer-target-props={target-category=TYPE_REFERENCE, implementation-data-type=Fr_17_Eray_ConfigType}
    Fr_ControllerInit: service-id=0, is-reentrant=true, is-synchronous=true
      return type Return: implementation-data-type=Std_ReturnType
      sw service arg Fr_CtrlIdx: implementation-data-type=uint8
    Fr_AllSlots: service-id=36, is-reentrant=true, is-synchronous=false
      return type Return: implementation-data-type=Std_ReturnType
      sw service arg Fr_CtrlIdx: implementation-data-type=uint8
    Fr_AllowColdstart: service-id=35, is-reentrant=true, is-synchronous=false
      return type Return: implementation-data-type=Std_ReturnType
      sw service arg Fr_CtrlIdx: implementation-data-type=uint8
    Fr_StartCommunication: service-id=3, is-reentrant=true, is-synchronous=false
      return type Return: implementation-data-type=Std_ReturnType
      sw service arg Fr_CtrlIdx: implementation-data-type=uint8
    Fr_GetPOCStatus: service-id=10, is-reentrant=true, is-synchronous=true
      return type Return: implementation-data-type=Std_ReturnType
      sw service arg Fr_CtrlIdx: implementation-data-type=uint8
      sw service arg Fr_POCStatusPtr: category=DATA_REFERENCE, sw-pointer-target-props={target-category=TYPE_REFERENCE, implementation-data-type=Fr_POCStatusType}
    Fr_GetGlobalTime: service-id=16, is-reentrant=true, is-synchronous=true
      return type Return: implementation-data-type=Std_ReturnType
      sw service arg Fr_CtrlIdx: implementation-data-type=uint8
      sw service arg Fr_CyclePtr: category=DATA_REFERENCE, sw-pointer-target-props={target-category=TYPE_REFERENCE, implementation-data-type=uint8}
      sw service arg Fr_MacroTickPtr: category=DATA_REFERENCE, sw-pointer-target-props={target-category=TYPE_REFERENCE, implementation-data-type=uint16}
    Fr_PrepareLPdu: service-id=31, is-reentrant=true, is-synchronous=true
      return type Return: implementation-data-type=Std_ReturnType
      sw service arg Fr_CtrlIdx: implementation-data-type=uint8
      sw service arg Fr_LPduIdx: implementation-data-type=uint16
    Fr_TransmitTxLPdu: service-id=11, is-reentrant=true, is-synchronous=false
      return type Return: implementation-data-type=Std_ReturnType
      4 x sw service arg:
        Fr_CtrlIdx: implementation-data-type=uint8
        Fr_LPduIdx: implementation-data-type=uint16
        Fr_LSduPtr: category=DATA_REFERENCE, sw-pointer-target-props={target-category=TYPE_REFERENCE, implementation-data-type=uint8}
        Fr_LSduLength: implementation-data-type=uint8
    Fr_CheckTxLPduStatus: service-id=13, is-reentrant=true, is-synchronous=true
      return type Return: implementation-data-type=Std_ReturnType
      sw service arg Fr_CtrlIdx: implementation-data-type=uint8
      sw service arg Fr_LPduIdx: implementation-data-type=uint16
      sw service arg Fr_TxLPduStatusPtr: category=DATA_REFERENCE, sw-pointer-target-props={target-category=TYPE_REFERENCE, implementation-data-type=Fr_TxLPduStatusType}
    Fr_ReceiveRxLPdu: service-id=12, is-reentrant=true, is-synchronous=true
      return type Return: implementation-data-type=Std_ReturnType
      5 x sw service arg:
        Fr_CtrlIdx: implementation-data-type=uint8
        Fr_LPduIdx: implementation-data-type=uint16
        Fr_LSduPtr: category=DATA_REFERENCE, sw-pointer-target-props={target-category=TYPE_REFERENCE, implementation-data-type=uint8}
        Fr_RxLPduStatusPtr: category=DATA_REFERENCE, sw-pointer-target-props={target-category=TYPE_REFERENCE, implementation-data-type=Fr_RxLPduStatusType}
        Fr_LSduLengthPtr: category=DATA_REFERENCE, sw-pointer-target-props={target-category=TYPE_REFERENCE, implementation-data-type=uint8}
    Fr_GetNmVector: service-id=34, is-reentrant=true, is-synchronous=true
      return type Return: implementation-data-type=Std_ReturnType
      sw service arg Fr_CtrlIdx: implementation-data-type=uint8
      sw service arg Fr_NmVectorPtr: category=DATA_REFERENCE, sw-pointer-target-props={target-category=TYPE_REFERENCE, implementation-data-type=uint8}
    Fr_CancelTxLPdu: service-id=45, is-reentrant=true, is-synchronous=true
      return type Return: implementation-data-type=Std_ReturnType
      sw service arg Fr_CtrlIdx: implementation-data-type=uint8
      sw service arg Fr_LPduIdx: implementation-data-type=uint16
    Fr_DisableLPdu: service-id=38, is-reentrant=true, is-synchronous=true
      return type Return: implementation-data-type=Std_ReturnType
      sw service arg Fr_CtrlIdx: implementation-data-type=uint8
      sw service arg Fr_LPduIdx: implementation-data-type=uint16
    Fr_SetWakeupChannel: service-id=7, is-reentrant=true, is-synchronous=true
      return type Return: implementation-data-type=Std_ReturnType
      sw service arg Fr_CtrlIdx: implementation-data-type=uint8
      sw service arg Fr_ChnlIdx: implementation-data-type=Fr_ChannelType
    Fr_SendWUP: service-id=6, is-reentrant=true, is-synchronous=false
      return type Return: implementation-data-type=Std_ReturnType
      sw service arg Fr_CtrlIdx: implementation-data-type=uint8
    Fr_SetAbsoluteTimer: service-id=17, is-reentrant=true, is-synchronous=true
      return type Return: implementation-data-type=Std_ReturnType
      4 x sw service arg, all with category=TYPE_REFERENCE:
        Fr_CtrlIdx: implementation-data-type=uint8
        Fr_AbsTimerIdx: implementation-data-type=uint8
        Fr_Cycle: implementation-data-type=uint8
        Fr_Offset: implementation-data-type=uint16
    Fr_EnableAbsoluteTimerIRQ: service-id=21, is-reentrant=true, is-synchronous=true
      return type Return: implementation-data-type=Std_ReturnType
      sw service arg Fr_CtrlIdx: implementation-data-type=uint8
      sw service arg Fr_AbsTimerIdx: implementation-data-type=uint8
    Fr_GetAbsoluteTimerIRQStatus: service-id=32, is-reentrant=true, is-synchronous=true
      return type Return: implementation-data-type=Std_ReturnType
      sw service arg Fr_CtrlIdx: implementation-data-type=uint8
      sw service arg Fr_AbsTimerIdx: implementation-data-type=uint8
      sw service arg Fr_IRQStatusPtr: category=DATA_REFERENCE, sw-pointer-target-props={target-category=TYPE_REFERENCE, implementation-data-type=boolean}
    Fr_AckAbsoluteTimerIRQ: service-id=23, is-reentrant=true, is-synchronous=true
      return type Return: implementation-data-type=Std_ReturnType
      sw service arg Fr_CtrlIdx: implementation-data-type=uint8
      sw service arg Fr_AbsTimerIdx: implementation-data-type=uint8
    Fr_DisableAbsoluteTimerIRQ: service-id=25, is-reentrant=true, is-synchronous=true
      return type Return: implementation-data-type=Std_ReturnType
      sw service arg Fr_CtrlIdx: implementation-data-type=uint8
      sw service arg Fr_AbsTimerIdx: implementation-data-type=uint8
    Fr_CancelAbsoluteTimer: service-id=19, is-reentrant=true, is-synchronous=true
      return type Return: implementation-data-type=Std_ReturnType
      sw service arg Fr_CtrlIdx: implementation-data-type=uint8
      sw service arg Fr_AbsTimerIdx: implementation-data-type=uint8
    Fr_GetChannelStatus: service-id=40, is-reentrant=true, is-synchronous=true
      return type Return: implementation-data-type=Std_ReturnType
      sw service arg Fr_CtrlIdx: implementation-data-type=uint8
      sw service arg Fr_ChannelAStatusPtr: category=DATA_REFERENCE, sw-pointer-target-props={target-category=TYPE_REFERENCE, implementation-data-type=uint16}
      sw service arg Fr_ChannelBStatusPtr: category=DATA_REFERENCE, sw-pointer-target-props={target-category=TYPE_REFERENCE, implementation-data-type=uint16}
    Fr_GetNumOfStartupFrames: service-id=39, is-reentrant=true, is-synchronous=true
      return type Return: implementation-data-type=Std_ReturnType
      sw service arg Fr_CtrlIdx: implementation-data-type=uint8
      sw service arg Fr_NumOfStartupFramesPtr: category=DATA_REFERENCE, sw-pointer-target-props={target-category=TYPE_REFERENCE, implementation-data-type=uint8}
    Fr_GetClockCorrection: service-id=41, is-reentrant=true, is-synchronous=true
      return type Return: implementation-data-type=Std_ReturnType
      sw service arg Fr_CtrlIdx: implementation-data-type=uint8
      sw service arg Fr_RateCorrectionPtr: category=DATA_REFERENCE, sw-pointer-target-props={target-category=TYPE_REFERENCE, implementation-data-type=sint16}
      sw service arg Fr_OffsetCorrectionPtr: category=DATA_REFERENCE, sw-pointer-target-props={target-category=TYPE_REFERENCE, implementation-data-type=sint32}
    Fr_GetSyncFrameList: service-id=42, is-reentrant=true, is-synchronous=true
      return type Return: implementation-data-type=Std_ReturnType
      6 x sw service arg:
        Fr_CtrlIdx: implementation-data-type=uint8
        Fr_ListSize: implementation-data-type=uint8
        Fr_ChannelAEvenListPtr: category=DATA_REFERENCE, sw-pointer-target-props={target-category=TYPE_REFERENCE, implementation-data-type=uint16}
        Fr_ChannelBEvenListPtr: category=DATA_REFERENCE, sw-pointer-target-props={target-category=TYPE_REFERENCE, implementation-data-type=uint16}
        Fr_ChannelAOddListPtr: category=DATA_REFERENCE, sw-pointer-target-props={target-category=TYPE_REFERENCE, implementation-data-type=uint16}
        Fr_ChannelBOddListPtr: category=DATA_REFERENCE, sw-pointer-target-props={target-category=TYPE_REFERENCE, implementation-data-type=uint16}
    Fr_GetWakeupRxStatus: service-id=43, is-reentrant=true, is-synchronous=true
      return type Return: implementation-data-type=Std_ReturnType
      sw service arg Fr_CtrlIdx: implementation-data-type=uint8
      sw service arg Fr_WakeupRxStatusPtr: category=DATA_REFERENCE, sw-pointer-target-props={target-category=TYPE_REFERENCE, implementation-data-type=uint8}
    Fr_ReadCCConfig: service-id=46, is-reentrant=true, is-synchronous=true
      return type Return: implementation-data-type=Std_ReturnType
      sw service arg Fr_CtrlIdx: implementation-data-type=uint8
      sw service arg Fr_ConfigParamIdx: implementation-data-type=uint8
      sw service arg Fr_ConfigParamValuePtr: category=DATA_REFERENCE, sw-pointer-target-props={target-category=TYPE_REFERENCE, implementation-data-type=uint32}
    Fr_AbortCommunication: service-id=5, is-reentrant=true, is-synchronous=true
      return type Return: implementation-data-type=Std_ReturnType
      sw service arg Fr_CtrlIdx: implementation-data-type=uint8
    Fr_HaltCommunication: service-id=4, is-reentrant=true, is-synchronous=false
      return type Return: implementation-data-type=Std_ReturnType
      sw service arg Fr_CtrlIdx: implementation-data-type=uint8
    Fr_ReconfigLPdu: service-id=37, is-reentrant=true, is-synchronous=true
      return type Return: implementation-data-type=Std_ReturnType
      8 x sw service arg, all with category=TYPE_REFERENCE:
        Fr_CtrlIdx: implementation-data-type=uint8
        Fr_LPduIdx: implementation-data-type=uint16
        Fr_FrameId: implementation-data-type=uint16
        Fr_ChnlIdx: implementation-data-type=Fr_ChannelType
        Fr_CycleRepetition: implementation-data-type=uint8
        Fr_CycleOffset: implementation-data-type=uint8
        Fr_PayloadLength: implementation-data-type=uint8
        Fr_HeaderCRC: implementation-data-type=uint16
    Fr_GetVersionInfo: service-id=27, is-reentrant=true, is-synchronous=true
      sw service arg VersioninfoPtr: category=DATA_REFERENCE, sw-pointer-target-props={target-category=TYPE_REFERENCE, implementation-data-type=Std_VersionInfoType}
package /AUTOSAR_Fr_17_Eray/Implementations
  bsw implementation Fr: programming-language=C, sw-version=10.40.1, vendor-id=17, ar-release-version=4.2.2, behavior=FrBehavior, vendor-api-infix=Eray, vendor-specific-module-def=Fr
    code-descriptors:
      code Files
        artifact-descriptors:
          short-label=ssc::src::Fr_17_Eray.c, category=SWSRC
          short-label=ssc::inc::Fr_17_Eray.h, category=SWHDR
    generated-artifacts:
      5 x dependency on artifact:
        Fr_PBcfg_c: artifact-descriptor={short-label=generate::template::src::Fr_17_Eray_PBcfg.c, category=SWTEMPLATE}, usages=EXECUTE
        Fr_PBcfg_h: artifact-descriptor={short-label=generate::template::inc::Fr_17_Eray_PBcfg.h, category=SWTEMPLATE}, usages=EXECUTE
        Fr_Cfg_h: artifact-descriptor={short-label=generate::template::inc::Fr_17_Eray_Cfg.h, category=SWTEMPLATE}, usages=COMPILE
        Fr_xdm: artifact-descriptor={short-label=config::Fr_17_Eray.xdm, category=SWTOOL}, usages=CODEGENERATION
        Fr_bmd: artifact-descriptor={short-label=autosar::TC39x::TC399x::Fr_17_Eray.bmd, category=SWTOOL}, usages=CODEGENERATION
    resource consumption ResourceConsumption
      7 x memory section:
        CONST_QM_LOCAL_8: alignment=8, sw-addrmethod=CONST
        CONST_QM_LOCAL_32: alignment=32, sw-addrmethod=CONST
        CONST_QM_LOCAL_UNSPECIFIED: alignment=UNSPECIFIED, sw-addrmethod=CONST
        VAR_CLEARED_QM_LOCAL_16: alignment=16, sw-addrmethod=VAR_CLEARED
        VAR_CLEARED_QM_LOCAL_32: alignment=32, sw-addrmethod=VAR_CLEARED
        CODE_QM_LOCAL: alignment=UNSPECIFIED, sw-addrmethod=CODE
        CONFIG_DATA_QM_LOCAL_UNSPECIFIED: alignment=UNSPECIFIED, sw-addrmethod=CONFIG_DATA
      section name prefix FR_17_ERAY
package /AUTOSAR_Fr_17_Eray/ImplementationDataTypes
  4 x impl type, all with category=STRUCTURE, type-emitter=BSW:
    Fr_17_Eray_ConfigType
      element CfgPtr: category=DATA_REFERENCE, sw-pointer-target-props={target-category=TYPE_REFERENCE, implementation-data-type=Fr_17_Eray_CCType}
      element Phy2LogIdxPtr: category=DATA_REFERENCE, sw-pointer-target-props={target-category=TYPE_REFERENCE, implementation-data-type=uint8}
    Fr_17_Eray_LPduConfigType
      4 x element, all with category=TYPE_REFERENCE:
        Wrhs1CfgVal: implementation-data-type=uint32
        Wrhs2CfgVal: implementation-data-type=uint32
        LpduReconfigurable: implementation-data-type=uint8
        FrDemFTSlotStatusErrId: implementation-data-type=Dem_EventIdType
    Fr_17_Eray_CCConfigType
      19 x element, all with category=TYPE_REFERENCE, implementation-data-type=uint32:
        Succ{1..3}CfgVal
        NemcCfgVal
        Prtc1CfgVal
        Prtc2CfgVal
        MhdcCfgVal
        Gtuc{01..11}CfgVal
        Cust1CfgVal
    Fr_17_Eray_CCType
      10 x element:
        CCCfgPtr: category=DATA_REFERENCE, sw-pointer-target-props={target-category=TYPE_REFERENCE, implementation-data-type=Fr_17_Eray_CCConfigType}
        LPduConfigPtr: category=DATA_REFERENCE, sw-pointer-target-props={target-category=TYPE_REFERENCE, implementation-data-type=Fr_17_Eray_LPduConfigType}
        ConfigParamPtr: category=DATA_REFERENCE, sw-pointer-target-props={target-category=TYPE_REFERENCE, implementation-data-type=uint32}
        LPduIdx2MsgBuffIdxPtr: category=DATA_REFERENCE, sw-pointer-target-props={target-category=TYPE_REFERENCE, implementation-data-type=uint8}
        DataPointerOffsetPtr: category=DATA_REFERENCE, sw-pointer-target-props={target-category=TYPE_REFERENCE, implementation-data-type=uint16}
        LPduCount: implementation-data-type=uint16
        FrClockDivider: implementation-data-type=uint8
        FrIsBuffReconfigOn: implementation-data-type=uint8
        FrDemCtrlTestResultId: implementation-data-type=Dem_EventIdType
        MsgBuffCountMax: implementation-data-type=uint8
